## package/Config.in
```kconfig
# br_pkg_repo autogen
menu "dywi/buildroot-packages [external repo]"
	source "package/diskid/Config.in"
	source "package/gentoo-functions/Config.in"
	source "package/ip-dedup/Config.in"

menu "perl_modules"
	source "package/perl-socket6/Config.in"
endmenu  # perl_modules

menu "shorewall"
	source "package/shorewall/Config.in"
	source "package/shorewall-core/Config.in"
	source "package/shorewall-hacks/Config.in"
	source "package/shorewall-init/Config.in"
endmenu  # shorewall
endmenu
```

## package/better-initramfs/Config.in
```kconfig
if BR2_PACKAGE_INITRAMFS_BETTER_INITRAMFS

comment "better-initramfs needs mdev or devtmpfs /dev management and no init system"
	depends on !BR2_INIT_NONE || ! ( \
		BR2_ROOTFS_DEVICE_CREATION_DYNAMIC_MDEV || \
		BR2_ROOTFS_DEVICE_CREATION_DYNAMIC_DEVTMPFS )

menuconfig BR2_PACKAGE_BETTER_INITRAMFS
	bool "better-initramfs"

	depends on BR2_PACKAGE_BUSYBOX
	depends on ( \
		BR2_ROOTFS_DEVICE_CREATION_DYNAMIC_MDEV || \
		BR2_ROOTFS_DEVICE_CREATION_DYNAMIC_DEVTMPFS )
	depends on BR2_INIT_NONE
	select BR2_PACKAGE_HAS_INITRAMFS

	help
		An initramfs solution with few dependencies, written in shell script
		language.

		Supports booting from disk (by dev/label/uuid), BCACHE, LVM, LUKS,
		software RAID and more.

		https://github.com/slashbeast/better-initramfs/blob/master/README.rst

		In order to get full functionality, one or more of the following
		packages should be selected:

		  o dropbear   (remote shell)
		  o lvm2       (LVM)
		  o cryptsetup (LUKS)
		  o askpass    (LUKS, remote shell) [not packaged]
		  o mdadm      (software-RAID)
		  o suspend    (resume from hibernate) [?]


if BR2_PACKAGE_BETTER_INITRAMFS

config BR2_PACKAGE_PROVIDES_INITRAMFS
	default "better-initramfs"

config BR2_PACKAGE_BETTER_INITRAMFS_KEYMAP_FILE
	string  "keymap file"
	default ""

	help
		better-initramfs supports loading of a keymap file,
		which helps to get your passphrases accepted ;)

config BR2_PACKAGE_BETTER_INITRAMFS_HOOK_DIRS
	string  "hook dirs"
	default ""

	help
		Allows to import initramfs hooks.

		Each dir should contain one or more of the following directories ("hook phases"):
		  o init
		  o early
		  o pre_newroot_mount
		  o post_newroot_mount [unofficial]
		  o pre_switch_root

endif # BR2_PACKAGE_BETTER_INITRAMFS
endif # BR2_PACKAGE_INITRAMFS_BETTER_INITRAMFS
```

## package/diskid/Config.in
```kconfig
config BR2_PACKAGE_DISKID
	bool "diskid"

	help
		`diskid` reads disk identifiers from devices and is a replacement for
		udev's `ata_id` program. This is useful for creating /dev/disk/by-id/
		links on systems where udev/systemd is not installed,
		e.g. when /dev is managed by mdev or devtmpfs.

		https://github.com/dywisor/diskid

if BR2_PACKAGE_DISKID
config BR2_PACKAGE_DISKID_LINK_HELPER
	bool "install create-diskid-links"

	depends on BR2_PACKAGE_BUSYBOX # script is hardwired to /bin/busybox ash

	help
		Installs a script for creating diskid links (/sbin/create-diskid-links).
		Suitable for small systems without disk hotplugging.
		Not capable of removing diskid links!

endif # BR2_PACKAGE_DISKID
```

## package/etckeeper/Config.in
```kconfig
config BR2_PACKAGE_ETCKEEPER
	bool "etckeeper"

	help
		A collection of tools to let /etc be stored in a repository

		https://etckeeper.branchable.com/
```

## package/gentoo-functions/Config.in
```kconfig
config BR2_PACKAGE_GENTOO_FUNCTIONS
	bool "gentoo-functions"

	help
		base functions for Gentoo systems

		Limitations:
		  o get_bootparam() is not usable unless gawk is also selected
		  o get_libdir() will waste some cycles on calling portageq

		https://github.com/gentoo/gentoo-functions
```

## package/initramfs/Config.in
```kconfig
choice
	prompt "initramfs implementation"
	default BR2_PACKAGE_INITRAMFS_NONE

	help
		Select initramfs implementation or none.

		Note that this option controls which initramfs is visible,
		it does not select any package.

	config BR2_PACKAGE_INITRAMFS_NONE
		bool "none"

		help
			no initramfs

	comment "other choices need no init system"
		depends on !BR2_INIT_NONE

	config BR2_PACKAGE_INITRAMFS_BETTER_INITRAMFS
		bool "better-initramfs"
		depends on BR2_INIT_NONE

		help
			Solid choice for booting normal systems.

	config BR2_PACKAGE_INITRAMFS_LIRAM_INITRAMFS
		bool "liram-initramfs"
		depends on BR2_INIT_NONE

		help
			Linux In RAM. Loads systems to RAM and boots them.
			Also supports booting of normal systems, but quite limited in
			comarision with better-initramfs.

endchoice

config BR2_PACKAGE_HAS_INITRAMFS
	bool

config BR2_PACKAGE_PROVIDES_INITRAMFS
	depends on BR2_PACKAGE_HAS_INITRAMFS
	string
```

## package/ip-dedup/Config.in
```kconfig
config BR2_PACKAGE_IP_DEDUP
	bool "ip-dedup"

	help
		`ip-dedup` merges and aggregates IPv4/IPv6 addresses/networks.

		https://github.com/dywisor/ip-dedup
```

## package/liram-initramfs/Config.in
```kconfig
if BR2_PACKAGE_INITRAMFS_LIRAM_INITRAMFS

comment "liram-initramfs needs mdev /dev management and no init system"
	depends on !BR2_ROOTFS_DEVICE_CREATION_DYNAMIC_MDEV || !BR2_INIT_NONE

menuconfig BR2_PACKAGE_LIRAM_INITRAMFS
	bool "liram-initramfs"

	depends on BR2_PACKAGE_BUSYBOX
	depends on BR2_ROOTFS_DEVICE_CREATION_DYNAMIC_MDEV
	depends on BR2_INIT_NONE
	select BR2_PACKAGE_HAS_INITRAMFS

	help
		An initramfs solution written in shell script language, targeted at
		loading systems into RAM (and booting them afterwards).
		Use cases include booting from Gentoo stage3 tarballs as well as
		booting semi-persistent systems (e.g. VDR).

		Also supports booting normal systems. Depending on the system setup,
		better-initramfs might be a more suitable choice.

		Basic Features (not depending on the boot "mode"):
		  o zram autoswap, partitions a fraction of the system memory into 1..<cpu core count> swap "disks"
		  o premounting of "simple" mountpoints in the real root (disk drives, tmpfs, loopback image files)
		  o limited support for LVM and software RAID, no support for LUKS
		  o creation of per-user temporary directories (/tmp/users/<name>)
		  o execution of real-root-provided hook scripts
		  o set -u zealot.

		The boot-to-RAM mode is split up into a specific part that populates
		the rootfs, which is offloaded to a so-called "liram layout", and
		a generic part that creates an empty rootfs (as tmpfs/zram/...),
		mounts a source for image files ("sysdisk", local disk or NFS)
		and manages the overall boot process.
		The sysdisk usually contains subdirectories with the actual image files
		("slot" directories, e.g. "armv5tel/factory").

		layouts don't need to be part of the initramfs, and can be injected
		via http, rsync or the sysdisk instead.
		Basically, a layout extracts tarballs, mounts squashfs images and tmpfs.
		The idea is to combine large "factory" image files (rootfs, usr etc.
		from a build host) with small machine-specific files (/etc, /var or just
		subdirs like /etc/vdr). Persistence is achieved by re-packing an image
		file.

		Features depending on the layout:
		  o zram as tmpfs-like disk mounts
		  o "writable" squashfs mounts (as aufs: squashfs image(s) + tmpfs/zram)
		  o arbitrary tmpfs/zram subdir mounts
		  o hand-over of firmware files and kernel modules

		Most of these features are always available,
		but need to be exposed/used by the layout.

		Optional Dependencies:
		  o full-featured tar, the busybox variant does not accept -p switch etc.
		  o ip (iproute2 or busybox) for network support
		  o rsync for --progress reports during file transfer
		  o mkswap/swapon for zram autoswap
		  o mkfs.ext4/mkfs.btrfs for zram disks
		  o aufs3-patched kernel
		  o mdadm/lvm2

		Optional Dependencies for the rootfs:
		  o liram-userspace/baselayout [NOT PACKAGED]
		  o liram-manage for persistent systems (image file creation helper) [NOT PACKAGED]

		liram is a subproject of shlib and has no dedicated website.
		https://github.com/dywisor/shlib

if BR2_PACKAGE_LIRAM_INITRAMFS

config BR2_PACKAGE_PROVIDES_INITRAMFS
	default "liram-initramfs"

config BR2_PACKAGE_LIRAM_INITRAMFS_NETSETUP_HELPER
	bool "install net-setup"

	help
		Installs /sbin/net-setup for rescue shell usage,
		which exposes the initramfs' network setup functionality.
		Not to be confused with the "net-setup" tool found in some live systems.

config BR2_PACKAGE_LIRAM_INITRAMFS_DROPBEAR_HELPER
	bool "install start-dropbear"

	depends on BR2_PACKAGE_DROPBEAR

	help
		Installs /usr/sbin/start-dropbear for rescue shell usage,
		which simply starts the dropbear SSH daemon.

config BR2_PACKAGE_LIRAM_INITRAMFS_LAYOUT_DIRS
	string  "directories with additional layout files"
	default ""

	help
		Allows to import layout files to /liram/layouts.

config BR2_PACKAGE_LIRAM_INITRAMFS_CMDLINE_FILE
	string  "embed cmdline file"
	default ""

endif # BR2_PACKAGE_LIRAM_INITRAMFS
endif # BR2_PACKAGE_INITRAMFS_LIRAM_INITRAMFS
```

## package/perl-socket6/Config.in
```kconfig
config BR2_PACKAGE_PERL_SOCKET6
	bool "perl-Socket6"

	depends on BR2_PACKAGE_PERL

	help
	  IPv6 related part of the C socket.h defines and structure manipulators

	  https://metacpan.org/pod/Socket6
```

## package/rfkill/Config.in
```kconfig
config BR2_PACKAGE_RFKILL
	bool "rfkill"

	help
		Tool to read and control rfkill status through /dev/rfkill

		https://www.kernel.org/pub/software/network/rfkill/
```

## package/shlib-src/Config.in
```kconfig
config BR2_PACKAGE_SHLIB_SRC
	bool "shlib modules"

	help
		shell module library - module files

if BR2_PACKAGE_SHLIB_SRC
	choice
		prompt "module loader"
		default BR2_PACKAGE_SHLIB_SRC_LOADER_NONE

		help
			Select a module file loader, each with its pros&cons (or none).

		config BR2_PACKAGE_SHLIB_SRC_LOADER_NONE
			bool "none"

			help
				Disables the installation of the module loader.

		config BR2_PACKAGE_SHLIB_SRC_LOADER_STATIC
			bool "static"

			help
				Installs a module loader that relies on statically resolved
				dependencies (at build time).

				  + works with most shells (ash, dash, bash, ...)
				  + faster module load time
				  - very limited support for more than one module root
				  - needs about 1M disk space, but compresses well (~24k)

		config BR2_PACKAGE_SHLIB_SRC_LOADER_DYNAMIC
			bool "dynamic"

			depends on BR2_PACKAGE_BASH

			help
				Installs the dynamic module loader, which resolved dependencies
				at runtime and is able to handle multiple module roots.

				  + supports multiple module roots (SHLIB_PATH=/A:/B)
				  + less disk space required
				  - slower module load time
				  - bash-only

		comment "dynamic loader needs bash"
			depends on !BR2_PACKAGE_BASH
	endchoice

	config BR2_PACKAGE_SHLIB_SRC_LOADER_STATIC_PROVIDE_LIB
		bool "provide shlib.sh library file"
		default y

		depends on !BR2_PACKAGE_SHLIB
		depends on BR2_PACKAGE_SHLIB_SRC_LOADER_STATIC

		help
			Installs /usr/share/shlib/default/shlib.sh as staticloader script file.


endif # BR2_PACKAGE_SHLIB_SRC
```

## package/shlib/Config.in
```kconfig
config BR2_PACKAGE_SHLIB
	bool "shlib (library file)"

	help
		shell module library

if BR2_PACKAGE_SHLIB
config BR2_PACKAGE_SHLIB_MODULES
	string  "modules"
	default "all"

	help
		Select modules to link.

		Defaults to "all" if empty.

config BR2_PACKAGE_SHLIB_DEPFILES
	string  ".depend files"
	default ""

	help
		Specifiy dependency files of your scripts.

config BR2_PACKAGE_SHLIB_SHLIBCC_FLAGS
	string  "additional shlibcc flags"
	default "--as-lib --strip-virtual"

	help
		Specify additional shlibcc flags for linking

endif # BR2_PACKAGE_SHLIB
```

## package/shlibcc/Config.in
```kconfig
config BR2_TARGET_SHLIBCC_FLAGS
	string "shlibcc flags"
	default "--strip-virtual --no-enclose-modules --keep-safety-checks=y"

	help
		shlibcc flags for script creation

config BR2_PACKAGE_SHLIBCC
	bool "shlibcc"

	depends on BR2_PACKAGE_PYTHON3

	help
		shlib module linker, normally not needed in target dir

		https://github.com/dywisor/shlibcc
```

## package/shorewall-core/Config.in
```kconfig
config BR2_PACKAGE_SHOREWALL_CORE
	bool "shorewall-core"

	depends on BR2_PACKAGE_BC
	depends on BR2_PACKAGE_IPROUTE2
	depends on BR2_PACKAGE_IPTABLES
	depends on BR2_PACKAGE_PERL

	help
		Shorewall firewall

		This selects the common library - required for all other products.

		https://shorewall.org/
```

## package/shorewall-hacks/Config.in
```kconfig
menuconfig BR2_PACKAGE_SHOREWALL_HACKS
	bool "shorewall-hacks"

	help
		Various 'enhancements' for running Shorewall on Buildroot.

if BR2_PACKAGE_SHOREWALL_HACKS

config BR2_PACKAGE_SHOREWALL_HACKS_REMOVE_ANNOTATED
	bool "remove dot-annotated files"
	default y

	help
		Remove descriptive configuration files.

endif # BR2_PACKAGE_SHOREWALL_HACKS
```

## package/shorewall-init/Config.in
```kconfig
config BR2_PACKAGE_SHOREWALL_INIT
	bool "shorewall-init"

	depends on BR2_PACKAGE_COREUTILS

	help
		Shorewall firewall - init

		https://shorewall.org/
```

## package/shorewall/Config.in
```kconfig
config BR2_PACKAGE_SHOREWALL
	bool "shorewall"

	depends on BR2_PACKAGE_SHOREWALL_CORE

	help
		Shorewall firewall - full IPv4

		https://shorewall.org/
```
